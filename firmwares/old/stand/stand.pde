

//    Poser action playback
//      This program was generated by Project Biped Poser to playback a specific action.
//    Use it as the starting point for your projects!
//
//    Copyright (C) 2012  Jonathan Dowdall, Project Biped (www.projectbiped.com)
//
//    This program is free software: you can redistribute it and/or modify
//    it under the terms of the GNU General Public License as published by
//    the Free Software Foundation, either version 3 of the License, or
//    (at your option) any later version.
//
//    This program is distributed in the hope that it will be useful,
//    but WITHOUT ANY WARRANTY; without even the implied warranty of
//    MERCHANTABILITY or FITNESS FOR A PARTICULAR PURPOSE.  See the
//    GNU General Public License for more details.
//
//    You should have received a copy of the GNU General Public License
//    along with this program.  If not, see <http://www.gnu.org/licenses/>.

#include <Servo.h> 

//////////////////////////////////////////////////////////////////////////////////////////////////////////////////////////////////////////////
// Constants
//////////////////////////////////////////////////////////////////////////////////////////////////////////////////////////////////////////////
const int maximumServoShieldPosition = 2200;   // the maximum pulse duration for the servo shield (2ms pulse)
const int minimumServoShieldPosition = 800;   // the minimum pulse duration for the servo shield (1ms pulse)
const int numberOfServos             = 12;      // the number of servos
const int numberOfJoints             = 12;
const int numberOfFrames             = 5;

/////////////////////////////////////////////////////////////////////////////////////////////////////////////////////
class Action
/////////////////////////////////////////////////////////////////////////////////////////////////////////////////////
{
  /////////////////////////////////////////////////////////////////////////////////////////////////////////////////////
  //  The Action class collects information necessary to perform a sequence of movements.     
  /////////////////////////////////////////////////////////////////////////////////////////////////////////////////////  
  
  /////////////////////////////////////////////////////////////////////////////////////////////////////////////////////
  //Members
  /////////////////////////////////////////////////////////////////////////////////////////////////////////////////////
  public:
    int             duration;      // Total duration of the action in milliseconds
    float           playbackTime;  // The playback time in milliseconds.
    unsigned long   lastTime;      // The playback time in milliseconds.
    int*            frames;        // Pointer to a two dimensional array containing the individual frames
    float           playbackSpeed; // The speed at which the action is played back (1 is realtime, 0.5 is half speed, 2.0 is twice realtime)

  /////////////////////////////////////////////////////////////////////////////////////////////////////////////////////
  //Methods
  /////////////////////////////////////////////////////////////////////////////////////////////////////////////////////
  
  /////////////////////////////////////////////////////////////////////////////////////////////////////////////////////
  Action(int setDuration, void* setFrames)
  /////////////////////////////////////////////////////////////////////////////////////////////////////////////////////
  {
    frames            = (int*)setFrames;
    duration          = setDuration;
    playbackTime      = 0;
    playbackSpeed     = 1.0;
    lastTime          = 0;
  }  
  
  /////////////////////////////////////////////////////////////////////////////////////////////////////////////////////
  void Update()
  /////////////////////////////////////////////////////////////////////////////////////////////////////////////////////
  {  
     // Get the current time.
     unsigned long currentTime = millis(); 
   
     // Update the playback time.
     playbackTime += (playbackSpeed * (float)(currentTime - lastTime));
     
     // Loop if the playback time is past the end of the action.
     if(playbackTime > duration)
       playbackTime = playbackTime - duration;
     
     // Remember the time.
     lastTime = currentTime;     
  }

  /////////////////////////////////////////////////////////////////////////////////////////////////////////////////////
  void GetCurrentFrame(int* frame)
  /////////////////////////////////////////////////////////////////////////////////////////////////////////////////////
  {
      //update each servo
      int* sourceFrame = frames + ((int)playbackTime/20)*numberOfJoints;
      for (int joint = 0; joint < numberOfJoints; joint++)
        frame[joint] = sourceFrame[joint];    
  }

};
//////////////////////////////////////////////////////////////////////////////////////////////////////////////////////////////////////////////
// Action Frames
//////////////////////////////////////////////////////////////////////////////////////////////////////////////////////////////////////////////
//Joints positions are in degrees * 100 (home position is 0 degrees)
/////////////////////////////////////////////
//JOINT INDEXES
//
//RIGHT LEG JOINTS
// 0 Right Ankle (roll)
// 1 Right Lower Leg 
// 2 Right Knee 
// 3 Right Middle Leg 
// 4 Right Upper Leg 
// 5 Right Hip (roll)
//LEFT LEG JOINTS
// 6 Left Ankle (roll)
// 7 Left Lower Leg 
// 8 Left Knee 
// 9 Left Middle Leg 
// 10 Left Upper Leg 
// 11 Left Hip (roll)
/////////////////////////////////////////////
int servoPins[numberOfServos] = {22, 24, 26, 28, 30, 32, 38, 40, 42, 44, 46, 48};  // the pin for each servo 
int frames[numberOfFrames][numberOfJoints] = {
                      {    0,     0,     0,     0,     0,     0,     0,     0,     0,     0,     0,     0 },
                      {    0,     0,     0,     0,     0,     0,     0,     0,     0,     0,     0,     0 },
                      {    0,     0,     0,     0,     0,     0,     0,     0,     0,     0,     0,     0 },
                      {    0,     0,     0,     0,     0,     0,     0,     0,     0,     0,     0,     0 },
                      {    0,     0,     0,     0,     0,     0,     0,     0,     0,     0,     0,     0 }
};

int servoCalibrations[numberOfJoints][3] = {
                      {7678, -23, -7003}, 
                      {2284, 234, -337}, 
                      {1900, -100, 300}, 
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                      {1700, -300, -2700}
};

//////////////////////////////////////////////////////////////////////////////////////////////////////////////////////////////////////////////
// Actions
//////////////////////////////////////////////////////////////////////////////////////////////////////////////////////////////////////////////
Action myAction(numberOfFrames * 20 , frames); //the action
Action* currentAction;                //pointer to the current action

//////////////////////////////////////////////////////////////////////////////////////////////////////////////////////////////////////////////
// Variables
//////////////////////////////////////////////////////////////////////////////////////////////////////////////////////////////////////////////
Servo servos[numberOfServos];  // create servo object to control a servo 

//////////////////////////////////////////////////////////////////////////////////////////////////////////////////////////////////////////////
void setup()
//////////////////////////////////////////////////////////////////////////////////////////////////////////////////////////////////////////////
{
  //set the initial action
  currentAction = &myAction;
  
  //wait for a second to begin (keeps the communication line open in case a new program is being downloaded)
  delay(1000);    
  
  //start up the communication
  Serial.begin(9600);  
  
  //initialize the servos
  initializeServos();
}

//////////////////////////////////////////////////////////////////////////////////////////////////////////////////////////////////////////////
void loop()
//////////////////////////////////////////////////////////////////////////////////////////////////////////////////////////////////////////////
{
  //this is the main update loop for the microcontroller
  
  //update the current action
  UpdateAction();
  
  //get the frame from the current action  
  int frame[numberOfServos];
  currentAction->GetCurrentFrame(frame);
  
  //set the servo positions for this frame number
  SetServoPositions(frame);        
  
  // Add a little delay.
  delay(2);                  
}

//////////////////////////////////////////////////////////////////////////////////////////////////////////////////////////////////////////////
void UpdateAction()
//////////////////////////////////////////////////////////////////////////////////////////////////////////////////////////////////////////////
{
  //check to see if the robot is walking
  if(currentAction == &myAction)
  {
    // TODO (you) : add some logic for your action here!
    
    // move to the next frame of the action
    currentAction->Update();    
  }  
}

//////////////////////////////////////////////////////////////////////////////////////////////////////////////////////////////////////////////
void initializeServos()
//////////////////////////////////////////////////////////////////////////////////////////////////////////////////////////////////////////////
{   
  // Assign the correct pin to each servo.
  for(int s = 0; s < numberOfServos; s++)
    servos[s].attach(servoPins[s]);  
}

//////////////////////////////////////////////////////////////////////////////////////////////////////////////////////////////////////////////
void SetServoPositions(int* frame)
//////////////////////////////////////////////////////////////////////////////////////////////////////////////////////////////////////////////
{
  //update each servo
  for (int servo = 0; servo < numberOfServos; servo++)
  {   
      // each servo position is sent as a 2 byte value (high byte, low byte) integer (from -32,768 to 32,767)
      // this number is encoding the angle of the servo. The number is 100 * the servo angle.  This allows for the
      // storage of 2 significant digits(i.e. the value can be from -60.00 to 60.00 and every value in between).
      // Also remember that the servos have a range of 120 degrees. The angle is written in positions
      // which range from a minimum of 800 (-60 degrees) and go to a maximum of 2200 (60 degrees)
          
      int value = frame[servo];      
      
      // flip for the left leg.
      if(servo >= numberOfServos/2)
        value = map(value, -6000,6000,6000,-6000);
      
      servos[servo].write(map(value, -6000,6000,800,2200));              // tell servo to go to position in variable 'pos'       

  }
}
