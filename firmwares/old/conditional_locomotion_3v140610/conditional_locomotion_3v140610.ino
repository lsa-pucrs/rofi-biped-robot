

//    Poser action playback
//      This program was generated by Project Biped Poser to playback a specific action.
//    Use it as the starting point for your projects!
//
//    Copyright (C) 2012  Jonathan Dowdall, Project Biped (www.projectbiped.com)
//
//    This program is free software: you can redistribute it and/or modify
//    it under the terms of the GNU General Public License as published by
//    the Free Software Foundation, either version 3 of the License, or
//    (at your option) any later version.
//
//    This program is distributed in the hope that it will be useful,
//    but WITHOUT ANY WARRANTY; without even the implied warranty of
//    MERCHANTABILITY or FITNESS FOR A PARTICULAR PURPOSE.  See the
//    GNU General Public License for more details.
//
//    You should have received a copy of the GNU General Public License
//    along with this program.  If not, see <http://www.gnu.org/licenses/>.

#include <Servo.h> 

//////////////////////////////////////////////////////////////////////////////////////////////////////////////////////////////////////////////
// Constants
//////////////////////////////////////////////////////////////////////////////////////////////////////////////////////////////////////////////
const int echoPin  = 7; //g
const int trigPin =  8;  //g
const int maximumServoShieldPosition = 2200;   // the maximum pulse duration for the servo shield (2ms pulse)
const int minimumServoShieldPosition = 800;   // the minimum pulse duration for the servo shield (1ms pulse)
const int numberOfServos             = 12;      // the number of servos
const int numberOfJoints             = 12;
String currentActionName = "";                //idicates the current action
int cont;
boolean playbackPlaying;

//////////////////////////////////////////////////////////////////////////////////////////////////////////////////////////////////////////////
// Action Frames
//////////////////////////////////////////////////////////////////////////////////////////////////////////////////////////////////////////////
//Joints positions are in degrees * 100 (home position is 0 degrees)
/////////////////////////////////////////////
//JOINT INDEXES
//
//RIGHT LEG JOINTS
// 0 Right Ankle (roll)
// 1 Right Lower Leg 
// 2 Right Knee 
// 3 Right Middle Leg 
// 4 Right Upper Leg 
// 5 Right Hip (roll)
//LEFT LEG JOINTS
// 6 Left Ankle (roll)
// 7 Left Lower Leg 
// 8 Left Knee 
// 9 Left Middle Leg 
// 10 Left Upper Leg 
// 11 Left Hip (roll)
/////////////////////////////////////////////
int servoPins[numberOfServos] = {22, 24, 26, 28, 30, 32, 38, 40, 42, 44, 46, 48};  // the pin for each servo 
int walk[39][numberOfJoints] = { //g frames[numberOfFrames][numberOfJoints]
                      {  707, -2393,     0,     0, -3100,  1800, -1800,     0,   800,     0,     0, -2300 },
                      { 1990, -2130,     0,     0, -3100,  2664, -2578,     0,   800,     0,     0, -2300 },
                      { 2497, -2234, -2771,  2867,  1248,  2847, -2604,     0,   800,     0,  -573, -1917 },
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                      {  520, -2012,   230,     0, -2788,  1331, -1663,   -80,   248,     0,   528, -1901 }
};

int rightTurn[24][numberOfJoints] = {
                      {    0,     0,     0,     0,     0,     0,     0,     0,     0,     0,     0,     0 },
                      { -330,  -148,  -330,  -180,   400,  -340,   340,     0,     0,     0,   200,   256 },
                      { -660,  -296,  -660,  -360,   800,  -680,   680,     0,     0,     0,   400,   512 },
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                      { -308,  -212,  -270,     6,   306,  -390,   169,   434,   165,   -60,   601,   255 }
};

int lookDown[30][numberOfJoints] = {
                      {    0,     0,     0,     0,     0,     0,     0,     0,     0,     0,     0,     0 },
                      {    0,     0,    70,  -417,     6,     0,     0,     0,     0,  -411,     6,     0 },
                      {    0,     0,   141,  -835,    13,     0,     0,     0,     0,  -822,    13,     0 },
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                      {    0,   306,   454,  -417,     6,     0,     0,   303,   458,  -411,     6,     0 }
};


int stand[5][numberOfJoints] = {
                      {    0,     0,     0,     0,     0,     0,     0,     0,     0,     0,     0,     0 },
                      {    0,     0,     0,     0,     0,     0,     0,     0,     0,     0,     0,     0 },
                      {    0,     0,     0,     0,     0,     0,     0,     0,     0,     0,     0,     0 },
                      {    0,     0,     0,     0,     0,     0,     0,     0,     0,     0,     0,     0 },
                      {    0,     0,     0,     0,     0,     0,     0,     0,     0,     0,     0,     0 }
};

int servoCalibrations[numberOfJoints][3] = {
                      {7678, -23, -7003}, 
                      {2284, 234, -337}, 
                      {1900, -100, 300}, 
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                      {1700, -300, -2700}
};


/////////////////////////////////////////////////////////////////////////////////////////////////////////////////////
class Action
/////////////////////////////////////////////////////////////////////////////////////////////////////////////////////
{
  /////////////////////////////////////////////////////////////////////////////////////////////////////////////////////
  //  The Action class collects information necessary to perform a sequence of movements.     
  /////////////////////////////////////////////////////////////////////////////////////////////////////////////////////  
  
  /////////////////////////////////////////////////////////////////////////////////////////////////////////////////////
  //Members
  /////////////////////////////////////////////////////////////////////////////////////////////////////////////////////
  public:
    int             duration;      // Total duration of the action in milliseconds
    float           playbackTime;  // The playback time in milliseconds.
    unsigned long   lastTime;      // The playback time in milliseconds.
    int*            frames;        // Pointer to a two dimensional array containing the individual frames
    float           playbackSpeed; // The speed at which the action is played back (1 is realtime, 0.5 is half speed, 2.0 is twice realtime)
    boolean         playbackEnd;
    int frameCont;
    int testCont;
  /////////////////////////////////////////////////////////////////////////////////////////////////////////////////////
  //Methods
  /////////////////////////////////////////////////////////////////////////////////////////////////////////////////////
  
  /////////////////////////////////////////////////////////////////////////////////////////////////////////////////////
  Action(int newDuration, void* newFrames)
  /////////////////////////////////////////////////////////////////////////////////////////////////////////////////////
  {
    frames            = (int*)newFrames;
    duration          = newDuration;
    playbackTime      = 0;
    playbackSpeed     = 0.57;
    lastTime          = 0;
    currentActionName = "stand";
  }  
    
  //g
  void setWalkAction(){
    frames            = (int*)walk;
    duration          = (39 * 20);
    playbackTime      = 0;
    playbackSpeed     = 0.57;
    //lastTime          = 0;
    currentActionName = "walk";
  }
  
  void setStandAction(){
    frames            = (int*)stand;
    duration          = (5 * 20);
    playbackTime      = 0;
    playbackSpeed     = 0.57;
    //lastTime          = 0;
    currentActionName = "stand";
  }
  
  void setRightTurnAction(){
    frames            = (int*)rightTurn;
    duration          = (24 * 20);
    playbackTime      = 0;
    playbackSpeed     = 0.22;
    //lastTime          = 0;
    currentActionName = "rightTurn";
  }
  
  void setLookDownAction(){
    frames            = (int*)lookDown;
    duration          = (30 * 20);
    playbackTime      = 0;
    playbackSpeed     = 0.57;
    //lastTime          = 0;
    currentActionName =  "lookDown";
  }
  //g#
  
  ///////////////////////////////////////g
  void setPlaybackSpeed(float newSpeed){//g
  ////////////////////////////////////////g
    playbackSpeed = newSpeed;
  }
  ///////////////////////////////////////g
  
  boolean playbackEndCheck(){
    return playbackEnd;
  }
  
  /////////////////////////////////////////////////////////////////////////////////////////////////////////////////////
  void Update()
  /////////////////////////////////////////////////////////////////////////////////////////////////////////////////////
  {  
     // Get the current time.
     unsigned long currentTime = millis(); 
   
     // Update the playback time.
     playbackTime += (playbackSpeed * (float)(currentTime - lastTime));
     
     // Loop if the playback time is past the end of the action.
     playbackEnd = false;
     if(playbackTime > duration){
       playbackTime = playbackTime - duration;
       playbackEnd = true; 
       //g#  
     }  
     
     // Remember the time.
     lastTime = currentTime; 
  }

  /////////////////////////////////////////////////////////////////////////////////////////////////////////////////////
  void GetCurrentFrame(int* frame)
  /////////////////////////////////////////////////////////////////////////////////////////////////////////////////////
  {
      //update each servo
      int* sourceFrame = frames + ((int)playbackTime/20)*numberOfJoints;      
      for (int joint = 0; joint < numberOfJoints; joint++)
          frame[joint] = sourceFrame[joint]; 
  }

};


//////////////////////////////////////////////////////////////////////////////////////////////////////////////////////////////////////////////
// Actions
//////////////////////////////////////////////////////////////////////////////////////////////////////////////////////////////////////////////
//Action myAction(numberOfFrames * 20 , frames); //the action
//Action walkAction(39 * 20 , walk); 
Action standAction(5 * 20 , stand); 
//Action rightTurnAction(24 * 20 , rightTurn);
//Action lookDownAction(30 * 20 , lookDown);
Action* currentAction; 

//////////////////////////////////////////////////////////////////////////////////////////////////////////////////////////////////////////////
// Variables
//////////////////////////////////////////////////////////////////////////////////////////////////////////////////////////////////////////////
Servo servos[numberOfServos];  // create servo object to control a servo 

//////////////////////////////////////////////////////////////////////////////////////////////////////////////////////////////////////////////
void setup()
//////////////////////////////////////////////////////////////////////////////////////////////////////////////////////////////////////////////
{
  //set the initial action
  //currentAction = &myAction; 
  currentAction = &standAction;//g
  playbackPlaying = true;
  //wait for a second to begin (keeps the communication line open in case a new program is being downloaded)
  delay(1000);    
  
  //start up the communication
  Serial.begin(9600);  
  
  
  //initialize the servos
  initializeServos();
  
  //g
  // Apply the servo calibrations to the joint positions.
  initializeActions();//g
}

//////////////////////////////////////////////////////////////////////////////////////////////////////////////////////////////////////////////
void loop()
//////////////////////////////////////////////////////////////////////////////////////////////////////////////////////////////////////////////
{
  //this is the main update loop for the microcontroller
  
  //update the current action
  UpdateAction();
  
  //get the frame from the current action  
  int frame[numberOfServos];
  if(playbackPlaying)
    currentAction->GetCurrentFrame(frame); 
  
  //set the servo positions for this frame number
  SetServoPositions(frame);        
  
  // Add a little delay.
  delay(1);                  
}

//////////////////////////////////////////////////////////////////////////////////////////////////////////////////////////////////////////////
//////////////////////////////////////////////////////////////////////////////////////////////////////////////////////////////////////////////
void UpdateAction()
//////////////////////////////////////////////////////////////////////////////////////////////////////////////////////////////////////////////
//////////////////////////////////////////////////////////////////////////////////////////////////////////////////////////////////////////////
{
   // TODO (you) : add some logic for your action here!
   //check to see if the robot is standing
   unsigned int distance = MeasureDistance();
   //Serial.print("Distance: ");
   //Serial.println(distance);
   
  if(currentAction->playbackEndCheck()){ //avoid changes in the middle of an animation     
     ///////////// STAND
     if(currentActionName == "stand"){
       Serial.println(" STAND ");
       if(distance>20)currentAction->setWalkAction();
       else currentAction->Update();
     } 
  
    /////////////// WALK
    else if(currentActionName == "walk"){  
      Serial.println(" WALK ");
      if(distance<10)currentAction->setStandAction();
      else if(distance>10&&distance<30)currentAction->setRightTurnAction(); 
      else currentAction->Update();
    }   
    
    ////////////// RIGHT
    else if(currentActionName == "rightTurn"){
       Serial.println(" RIGHT");
       if(distance>40)currentAction->setStandAction(); 
       else currentAction->Update(); 
    }  
    
//    ////////////// LOOK
//    else if(currentActionName == "walk" && cont>=4){
//      currentAction->setLookDownAction(); 
//      if(cont>=5){
//        playbackPlaying = false;
//        if(cont>=100){
//          playbackPlaying = true;
//          cont=0;
//          currentAction->setStandAction(); 
//        }    
//        else cont++;
//      }
//      else{ 
//        cont++;
//       currentAction->Update(); 
//      }
//    }  
//    cont++;  
  }
  else currentAction->Update();
  Serial.println(cont);
  
}
//////////////////////////////////////////////////////////////////////////////////////////////////////////////////////////////////////////////
void initializeServos()
//////////////////////////////////////////////////////////////////////////////////////////////////////////////////////////////////////////////
{   
  // Assign the correct pin to each servo.
  for(int s = 0; s < numberOfServos; s++)
    servos[s].attach(servoPins[s]);  
}

//////////////////////////////////////////////////////////////////////////////////////////////////////////////////////////////////////////////
void SetServoPositions(int* frame)
//////////////////////////////////////////////////////////////////////////////////////////////////////////////////////////////////////////////
{
  //update each servo
  for (int servo = 0; servo < numberOfServos; servo++)
  {   
      // each servo position is sent as a 2 byte value (high byte, low byte) integer (from -32,768 to 32,767)
      // this number is encoding the angle of the servo. The number is 100 * the servo angle.  This allows for the
      // storage of 2 significant digits(i.e. the value can be from -60.00 to 60.00 and every value in between).
      // Also remember that the servos have a range of 120 degrees. The angle is written in positions
      // which range from a minimum of 800 (-60 degrees) and go to a maximum of 2200 (60 degrees)
          
      int value = frame[servo];      
      
      // flip for the left leg.
      if(servo >= numberOfServos/2)
        value = map(value, -6000,6000,6000,-6000);
      
      servos[servo].write(map(value, -6000,6000,800,2200));              // tell servo to go to position in variable 'pos'       

  }
}


//g
//////////////////////////////////////////////////////////////////////////////////////////////////////////////////////////////////////////////
void initializeActions()//g
//////////////////////////////////////////////////////////////////////////////////////////////////////////////////////////////////////////////
{   
  //And ApplyCalibration
  // Apply the servo calibrations to each frame of the animation.
  // This is done before hand to keep from slowing down the playback.
  // The frames could also be stored with the calibrations already
  // applied, however leaving the calibration seperate allows other
  // ROFIs to use this same action with their own calibration.
  
  
  //walk
  int numberOfFrames=39;
  for(int f = 0; f < numberOfFrames; f++)
    for(int s = 0; s < numberOfServos; s++)    
      walk[f][s] = CorrectJointAngle(walk[f][s], s);
     
  //stand
  numberOfFrames=5;
  for(int f = 0; f < numberOfFrames; f++)
    for(int s = 0; s < numberOfServos; s++)    
      stand[f][s] = CorrectJointAngle(stand[f][s], s); 
      
  //rightTurn
  numberOfFrames=24;
  for(int f = 0; f < numberOfFrames; f++)
    for(int s = 0; s < numberOfServos; s++)    
      rightTurn[f][s] = CorrectJointAngle(rightTurn[f][s], s); 
      
  //lookDown
  numberOfFrames=30;
  for(int f = 0; f < numberOfFrames; f++)
    for(int s = 0; s < numberOfServos; s++)    
      lookDown[f][s] = CorrectJointAngle(lookDown[f][s], s);
      
}

/////////////////////////////////////////////////////////////////////////////////////////////////////////////////////
double CorrectJointAngle(double inputAngle, int servo)
/////////////////////////////////////////////////////////////////////////////////////////////////////////////////////
{
  // The input angle is what the angle should be.
  // The corrected angle is the angle that has to be sent to the servo to achieve the input angle.
  if (inputAngle > 0)
    // Do a two point calibration between the middle and high corrected values.
    return map(inputAngle, 0, 4500, 0 + servoCalibrations[servo][1], 4500 + servoCalibrations[servo][2]);
  else
    // Do a two point calibration between the low and middle corrected values.
    return map(inputAngle, -4500, 0, -4500 + servoCalibrations[servo][0], 0 + servoCalibrations[servo][1]);
}
//#g

//g
//////////////////////////////////////////////////////////////////////////////////////////////////////////////////////////////////////////////
long MeasureDistance()
//////////////////////////////////////////////////////////////////////////////////////////////////////////////////////////////////////////////
{
  //g
  int maximumRange = 200; // Maximum range needed
  int minimumRange = 0; // Minimum range needed
  long duration, distance; // Duration used to calculate distance
  pinMode(trigPin, OUTPUT);
  pinMode(echoPin, INPUT);
  
  /* The following trigPin/echoPin cycle is used to determine the
  distance of the nearest object by bouncing soundwaves off of it. */ 
  digitalWrite(trigPin, LOW); 
  delayMicroseconds(2); 
  
  digitalWrite(trigPin, HIGH);
  delayMicroseconds(10); 
   
  digitalWrite(trigPin, LOW);
  duration = pulseIn(echoPin, HIGH);
   
  //Calculate the distance (in cm) based on the speed of sound.
  distance = duration/58.2; //g
   
  if (distance >= maximumRange || distance <= minimumRange){
  /* Send a negative number to computer to indicate "out of range" */
  Serial.println("-1");
  }
  else return distance;//g
}
//#g
